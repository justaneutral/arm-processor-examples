/**
 * @cliArgs --device "AM62Dx" --package "ANF" --part "AM62D24-G" --context "a53ss0-0" --product "MCU_PLUS_SDK_AM62Dx@10.00.00"
 * @versions {"tool":"1.20.999+143"}
 */

/**
 * Import the modules used in this configuration.
 */
const ipc        = scripting.addModule("/drivers/ipc/ipc");
const mcasp      = scripting.addModule("/drivers/mcasp/mcasp", {}, false);
const mcasp1     = mcasp.addInstance();
const udma       = scripting.addModule("/drivers/udma/udma", {}, false);
const udma1      = udma.addInstance();
const udma2      = udma.addInstance();
const debug_log  = scripting.addModule("/kernel/dpl/debug_log");
const mmu_armv8  = scripting.addModule("/kernel/dpl/mmu_armv8", {}, false);
const mmu_armv81 = mmu_armv8.addInstance();
const mmu_armv82 = mmu_armv8.addInstance();
const mmu_armv83 = mmu_armv8.addInstance();
const mmu_armv84 = mmu_armv8.addInstance();

/**
 * Write custom configuration values to the imported modules.
 */
ipc.enableLinuxIpc = false;
ipc.r5fss0_0       = "NONE";
ipc.c75ss0_0       = "notify";
ipc.mcu_r5fss0_0   = "notify";

mcasp1.$name                                   = "CONFIG_MCASP0";
mcasp1.txDataMask                              = 0xFFFFFFFF;
mcasp1.rxDataMask                              = 0xFFFFFFFF;
mcasp1.txActiveSlotMask                        = 0x3;
mcasp1.enableLoopback                          = false;
mcasp1.txCallbackFxn                           = "mcasp_txCallback";
mcasp1.rxCallbackFxn                           = "mcasp_rxCallback";
mcasp1.RxMode                                  = "TDM";
mcasp1.rxActiveSlotMask                        = 0xFF;
mcasp1.clkSyncMode                             = "ASYNC";
mcasp1.txHclkSource                            = 0;
mcasp1.rxBitClkPolarity                        = 0;
mcasp1.NumRxSlots                              = 8;
mcasp1.rxFsPolarity                            = 0;
mcasp1.txHclkSourceMux                         = 3;
mcasp1.rxHclkSource                            = 0;
mcasp1.rxHclkSourceMux                         = 3;
mcasp1.skipDriverOpen                          = true;
mcasp1.MCASP.$assignAllowConflicts             = "MCASP2";
mcasp1.mcaspSer.create(5);
mcasp1.mcaspSer[0].$name                       = "CONFIG_MCASP_SER0";
mcasp1.mcaspSer[0].MCASP.$assignAllowConflicts = "MCASP2";
mcasp1.mcaspSer[0].MCASP.AXR0.$assign          = "GPMC0_AD8";
mcasp1.mcaspSer[1].$name                       = "CONFIG_MCASP_SER1";
mcasp1.mcaspSer[1].serNum                      = 1;
mcasp1.mcaspSer[1].MCASP.$assignAllowConflicts = "MCASP2";
mcasp1.mcaspSer[1].MCASP.AXR1.$assign          = "GPMC0_AD9";
mcasp1.mcaspSer[2].$name                       = "CONFIG_MCASP_SER2";
mcasp1.mcaspSer[2].serNum                      = 3;
mcasp1.mcaspSer[2].MCASP.$assignAllowConflicts = "MCASP2";
mcasp1.mcaspSer[2].MCASP.AXR3.$assign          = "GPMC0_AD11";
mcasp1.mcaspSer[3].$name                       = "CONFIG_MCASP_SER3";
mcasp1.mcaspSer[3].serNum                      = 4;
mcasp1.mcaspSer[3].MCASP.$assignAllowConflicts = "MCASP2";
mcasp1.mcaspSer[3].MCASP.AXR4.$assign          = "GPMC0_AD0";
mcasp1.mcaspSer[4].$name                       = "CONFIG_MCASP_SER4";
mcasp1.mcaspSer[4].serNum                      = 14;
mcasp1.mcaspSer[4].dataDir                     = "Receive";
mcasp1.mcaspSer[4].MCASP.$assignAllowConflicts = "MCASP2";
mcasp1.mcaspSer[4].MCASP.AXR14.$assign         = "GPMC0_CSn0";
scripting.suppress("Resource conflict,MCASP2 is also in use by @@@.+?@@@, @@@.+?@@@, @@@.+?@@@, @@@.+?@@@, @@@.+?@@@", mcasp1.MCASP, "$assign");
scripting.suppress("Resource conflict,MCASP2 is also in use by @@@.+?@@@, @@@.+?@@@, @@@.+?@@@, @@@.+?@@@, @@@.+?@@@", mcasp1.mcaspSer[0].MCASP, "$assign");
scripting.suppress("Resource conflict,MCASP2 is also in use by @@@.+?@@@, @@@.+?@@@, @@@.+?@@@, @@@.+?@@@, @@@.+?@@@", mcasp1.mcaspSer[1].MCASP, "$assign");
scripting.suppress("Resource conflict,MCASP2 is also in use by @@@.+?@@@, @@@.+?@@@, @@@.+?@@@, @@@.+?@@@, @@@.+?@@@", mcasp1.mcaspSer[2].MCASP, "$assign");
scripting.suppress("Resource conflict,MCASP2 is also in use by @@@.+?@@@, @@@.+?@@@, @@@.+?@@@, @@@.+?@@@, @@@.+?@@@", mcasp1.mcaspSer[3].MCASP, "$assign");
scripting.suppress("Resource conflict,MCASP2 is also in use by @@@.+?@@@, @@@.+?@@@, @@@.+?@@@, @@@.+?@@@, @@@.+?@@@", mcasp1.mcaspSer[4].MCASP, "$assign");

udma1.$name              = "CONFIG_UDMA0";
mcasp1.bcDmaDriver       = udma1;

udma2.$name              = "CONFIG_UDMA1";
mcasp1.pktDmaDriver      = udma2;

debug_log.enableLogZoneWarning = false;
debug_log.enableLogZoneError   = false;

mmu_armv81.size  = 0x80000000;
mmu_armv81.$name = "SOC_MEM_REGION";

mmu_armv82.vAddr     = 0x80000000;
mmu_armv82.pAddr     = 0x80000000;
mmu_armv82.size      = 0x80000000;
mmu_armv82.attribute = "MAIR7";
mmu_armv82.$name     = "DDR_REGION";

mmu_armv83.$name     = "SHARED_HEAP_MEM";
mmu_armv83.vAddr     = 0xA1000000;
mmu_armv83.pAddr     = 0xA1000000;
mmu_armv83.size      = 0x40000;
mmu_armv83.attribute = "MAIR4";

mmu_armv84.$name     = "RTOS_NORTOS_IPC_VRING";
mmu_armv84.vAddr     = 0xA0400000;
mmu_armv84.pAddr     = 0xA0400000;
mmu_armv84.size      = 0x300000;
mmu_armv84.attribute = "MAIR4";

/**
 * Pinmux solution for unlocked pins/peripherals. This ensures that minor changes to the automatic solver in a future
 * version of the tool will not impact the pinmux you originally saw.  These lines can be completely deleted in order to
 * re-solve from scratch.
 */
mcasp1.MCASP.AFSX.$suggestSolution               = "GPMC0_AD12";
mcasp1.MCASP.ACLKX.$suggestSolution              = "GPMC0_AD13";
mcasp1.MCASP.AFSR.$suggestSolution               = "GPMC0_AD14";
mcasp1.MCASP.ACLKR.$suggestSolution              = "GPMC0_AD15";
mcasp1.SYSTEM.$suggestSolution                   = "SYSTEM0";
mcasp1.SYSTEM.AUDIO_EXT_REFCLK1.$suggestSolution = "GPMC0_WPn";
